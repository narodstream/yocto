## conf/local.conf
```bitbake
BB_NUMBER_THREADS ?= "8"
PARALLEL_MAKE ?= "-j 6"
MACHINE = "raspberrypi3-custom"
DL_DIR = "/opt/yocto/cache/downloads"
SSTATE_DIR = "/opt/yocto/cache/sstate"
DISTRO = "example-distro"
PACKAGE_CLASSES ?= "package_ipk"
EXTRA_IMAGE_FEATURES ?= "debug-tweaks tools-debug"
USER_CLASSES ?= "buildstats image-mklibs image-prelink"
PATCHRESOLVE = "noop"
BB_DISKMON_DIRS ??= "\
    STOPTASKS,${TMPDIR},1G,100K \
    STOPTASKS,${DL_DIR},1G,100K \
    STOPTASKS,${SSTATE_DIR},1G,100K \
    STOPTASKS,/tmp,100M,100K \
    ABORT,${TMPDIR},100M,1K \
    ABORT,${DL_DIR},100M,1K \
    ABORT,${SSTATE_DIR},100M,1K \
    ABORT,/tmp,10M,1K"
SSTATE_MIRRORS = "\
file://.* http://sstate.yoctoproject.org/dev/PATH;downloadfilename=PATH \n \
file://.* http://sstate.yoctoproject.org/2.6/PATH;downloadfilename=PATH \n \
file://.* http://sstate.yoctoproject.org/2.7/PATH;downloadfilename=PATH \n \
"
CONF_VERSION = "1"
```

## meta-custom-old/conf/distro/example-distro.conf
```bitbake
MAINTAINER = "nstream <vladimir035@gmail.com>"

require conf/distro/poky.conf

DISTRO = "example-distro"
DISTRO_NAME = "example distro"
DISTRO_VERSION = "1.0"
DISTRO_CODENAME = "codename"
SDK_VENDOR = "-exampledistro"
SDK_VERSION = "${@'${DISTRO_VERSION}'.replace('snapshot-${DATE}', 'snapshot')}"

hostname_pn-base-files = "nstream"

# Replace sysv with systemd
DISTRO_FEATURES += "systemd wifi opengl"
VIRTUAL-RUNTIME_init_manager = "systemd"
DISTRO_FEATURES_remove += " sysvinit bluetooth wayland pcmcia pulseaudio bluez5 pci ext2 irda x11 nfc ptest 3g jpeg"
VIRTUAL-RUNTIME_initscripts = "systemd-compat-units"
DISTRO_FEATURES_BACKFILL_CONSIDERED += "sysvinit"

# Set default timezone
DEFAULT_TIMEZONE = "Europe/Moscow"
```

## meta-custom_old5/conf/distro/example-distro.conf
```bitbake
# Base this distro on poky
require conf/distro/openstlinux-weston.conf

DISTRO = "example-distro"
DISTRO_NAME = "example-distro"
DISTRO_VERSION = "1.0"
DISTRO_CODENAME = "example-distro"
SDK_VENDOR = "-exampledistro"
SDK_VERSION := "${@'${DISTRO_VERSION}'.replace('snapshot-${DATE}', 'snapshot')}"

# The following replaces sysvinit with systemd along with the features necessary for Kodi
#DISTRO_FEATURES += "glx"
#DISTRO_FEATURES_remove += "xcomposite-glx"
PACKAGECONFIG_remove_pn-qtwayland = "xcomposite-glx"
```
